//#pragma src
//=========================================================
// src/Interrupts.c: generated by Hardware Configurator
//
// This file will be regenerated when saving a document.
// leave the sections inside the "$[...]" comment tags alone
// or they will be overwritten!!
//=========================================================

// USER INCLUDES
#include "main.h"
#include "gen.h"
#include "button.h"
#include "SSD1306.h"

//-----------------------------------------------------------------------------
// TIMER2_ISR
//-----------------------------------------------------------------------------
// enters interrupt every 1ms
//-----------------------------------------------------------------------------
// every 1ms timer
SI_INTERRUPT (TIMER2_ISR, TIMER2_IRQn)
  {
    // advance delay timer
    if(delay_on)
      {
        if(tmp_millis!=0)
          { tmp_millis--;}
        else
          { delay_on=0;}
      }

#ifdef SCROLLING
  if(scrolldelay>0)scrolldelay--;
#endif

    TMR2CN0_TF2H = 0;
  }
//-----------------------------------------------------------------------------
// TIMER0_ISR
//-----------------------------------------------------------------------------
//
// TIMER0 ISR Content goes here. Remember to clear flag bits:
// TCON::TF0 (Timer 0 Overflow Flag)
//
//-----------------------------------------------------------------------------
// every 32ms while button is pressed
SI_INTERRUPT (TIMER0_ISR, TIMER0_IRQn)
  {
    TCON_TF0=0;
    buttoncntr++;
    buttonstate = BUT_PRESSED;

    // counter for config button delays
    if(configcounter_s!=0)configcounter_s--;
}

//-----------------------------------------------------------------------------
// INT1_ISR
//-----------------------------------------------------------------------------
//
// INT1 ISR Content goes here. Remember to clear flag bits:
// TCON::IE1 (External Interrupt 1)
//
//-----------------------------------------------------------------------------
// Interrupt on button release
SI_INTERRUPT (INT1_ISR, INT1_IRQn)
  {
    if(buttoncntr>161)
      { // about 5 seconds
        buttonstate = BUT_LONGPRESS;
      }
    else if(buttoncntr>3)
      {
        buttonstate = BUT_SHORTPRESS;
      }
    buttoncntr=0;
  }

//-----------------------------------------------------------------------------
// PCA0_ISR
//-----------------------------------------------------------------------------
//
// PCA0 ISR Content goes here. Remember to clear flag bits:
// PCA0CN0::CCF0 (PCA Module 0 Capture/Compare Flag)
// PCA0CN0::CCF1 (PCA Module 1 Capture/Compare Flag)
// PCA0CN0::CCF2 (PCA Module 2 Capture/Compare Flag)
// PCA0CN0::CF (PCA Counter/Timer Overflow Flag)
// PCA0PWM::COVF (Cycle Overflow Flag)
//
//-----------------------------------------------------------------------------
// general timer - every 1/10 second (100ms)
SI_INTERRUPT (PCA0_ISR, PCA0_IRQn)
  {
    PCA0=0;
    PCA0CN0_CCF0=0;
	
	pcacntr_s--;
	if(pcacntr_s==0){
		second_tick = 1;
		pcacntr_s = 10;
	}
	
	if(configflashcntr!=0)configflashcntr--;
  }

