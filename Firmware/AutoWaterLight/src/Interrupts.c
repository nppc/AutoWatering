//#pragma src
//=========================================================
// src/Interrupts.c: generated by Hardware Configurator
//
// This file will be regenerated when saving a document.
// leave the sections inside the "$[...]" comment tags alone
// or they will be overwritten!!
//=========================================================

// USER INCLUDES
#include "main.h"
#include "gen.h"
#include "button.h"
#include "SSD1306.h"

//-----------------------------------------------------------------------------
// TIMER2_ISR
//-----------------------------------------------------------------------------
// enters interrupt every 1ms
//-----------------------------------------------------------------------------
// every 1ms timer
SI_INTERRUPT (TIMER2_ISR, TIMER2_IRQn)
  {
    // advance delay timer
    if(delay_on) {
        if(tmp_millis!=0)
          { tmp_millis--;}
        else
          { delay_on=0;}
    }

    // count 10s of second and seconds
    pcacntr_s10--;
    if(pcacntr_s10==0){
      pcacntr_s10 = 100;

      pcacntr_s--;
      if(pcacntr_s==0){
        second_tick = 1;
        pcacntr_s = 10;
      }

      // counter for config logic delays
      if(configcounter_s!=0)configcounter_s--;

      // counter for config data flashing on screen
      if(configflashcntr!=0)configflashcntr--;
    }

    // smooth pwm adjust
    if(pwmglob.cur_out[0]<pwmglob.set_out[0]){pwmglob.cur_out[0]++;pwmOut0_update = 1;PCA0CPM0 |=(PCA0CPM0_ECCF__BMASK);} // adjust and enable interrupt
    else if(pwmglob.cur_out[0]>pwmglob.set_out[0]){pwmglob.cur_out[0]--;pwmOut0_update = 1;PCA0CPM0 |=(PCA0CPM0_ECCF__BMASK);} // adjust and enable interrupt
    if(pwmglob.cur_out[1]<pwmglob.set_out[1]){pwmglob.cur_out[1]++;pwmOut1_update = 1;PCA0CPM1 |=(PCA0CPM1_ECCF__BMASK);} // adjust and enable interrupt
    else if(pwmglob.cur_out[1]>pwmglob.set_out[1]){pwmglob.cur_out[1]--;pwmOut1_update = 1;PCA0CPM1 |=(PCA0CPM1_ECCF__BMASK);} // adjust and enable interrupt
    if(pwmglob.cur_out[2]<pwmglob.set_out[2]){pwmglob.cur_out[2]++;pwmOut2_update = 1;PCA0CPM2 |=(PCA0CPM2_ECCF__BMASK);} // adjust and enable interrupt
    else if(pwmglob.cur_out[2]>pwmglob.set_out[2]){pwmglob.cur_out[2]--;pwmOut2_update = 1;PCA0CPM2 |=(PCA0CPM2_ECCF__BMASK);} // adjust and enable interrupt


#ifdef SCROLLING
  if(scrolldelay>0)scrolldelay--;
#endif

    TMR2CN0_TF2H = 0;
  }
//-----------------------------------------------------------------------------
// TIMER0_ISR
//-----------------------------------------------------------------------------
//
// TIMER0 ISR Content goes here. Remember to clear flag bits:
// TCON::TF0 (Timer 0 Overflow Flag)
//
//-----------------------------------------------------------------------------
// every 32ms while button is pressed
SI_INTERRUPT (TIMER0_ISR, TIMER0_IRQn)
  {
    TCON_TF0=0;
    buttoncntr++;
    buttonstate = BUT_PRESSED;
}

//-----------------------------------------------------------------------------
// INT1_ISR
//-----------------------------------------------------------------------------
//
// INT1 ISR Content goes here. Remember to clear flag bits:
// TCON::IE1 (External Interrupt 1)
//
//-----------------------------------------------------------------------------
// Interrupt on button release
SI_INTERRUPT (INT1_ISR, INT1_IRQn)
  {
    if(buttoncntr>161)
      { // about 5 seconds
        buttonstate = BUT_LONGPRESS;
      }
    else if(buttoncntr>3)
      {
        buttonstate = BUT_SHORTPRESS;
      }
    buttoncntr=0;
  }

//-----------------------------------------------------------------------------
// PCA0_ISR
//-----------------------------------------------------------------------------
SI_INTERRUPT (PCA0_ISR, PCA0_IRQn)
  {
  U16_U8 tmp;
  if(pwmOut2_update){
    pwmOut2_update = 0;
    PCA0CN0_CCF2=0; // reset interrupt flag
    PCA0CPM2 &=~(PCA0CPM2_ECCF__BMASK); // disable interrupt until we will need it.
    // update PWM
    tmp.u16 = 1024 - pwmglob.cur_out[2];
    // convert 16bit to 2x8bit
    PCA0CPL2 = tmp.u8[1];
    PCA0CPH2 = tmp.u8[0];
  }

  if(pwmOut1_update){
    pwmOut1_update = 0;
    PCA0CN0_CCF1=0; // reset interrupt flag
    PCA0CPM1 &=~(PCA0CPM1_ECCF__BMASK); // disable interrupt until we will need it.
    // update PWM
    tmp.u16 = 1024 - pwmglob.cur_out[1];
    // convert 16bit to 2x8bit
    PCA0CPL1 = tmp.u8[1];
    PCA0CPH1 = tmp.u8[0];
  }

  if(pwmOut0_update){
    pwmOut0_update = 0;
    PCA0CN0_CCF0=0; // reset interrupt flag
    PCA0CPM0 &=~(PCA0CPM0_ECCF__BMASK); // disable interrupt until we will need it.
    // update PWM
    tmp.u16 = 1024 - pwmglob.cur_out[0];
    // convert 16bit to 2x8bit
    PCA0CPL0 = tmp.u8[1];
    PCA0CPH0 = tmp.u8[0];
  }
}

